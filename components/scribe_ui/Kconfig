## components/scribe_ui/Kconfig
```kconfig
menu "Scribe UI"

config SCRIBE_WOKWI_SIM
    bool "Enable Wokwi simulator display config"
    default n
    help
        Use SPI ILI9341 settings and Wokwi pin mapping for the simulator.

endmenu
```

## sdkconfig.defaults
```kconfig
# Scribe Firmware - Default Configuration
# Target: ESP32-P4

CONFIG_ESPTOOLPY_FLASHSIZE_16MB=y
CONFIG_ESPTOOLPY_FLASHSIZE="16MB"
CONFIG_PARTITION_TABLE_CUSTOM=y
CONFIG_PARTITION_TABLE_CUSTOM_FILENAME="partitions.csv"
CONFIG_PARTITION_TABLE_OFFSET=0x8000

# LVGL Configuration
CONFIG_LV_FONT_MONTSERRAT_12=y
CONFIG_LV_FONT_MONTSERRAT_14=y
CONFIG_LV_FONT_MONTSERRAT_16=y
CONFIG_LV_FONT_MONTSERRAT_18=y
CONFIG_LV_FONT_MONTSERRAT_20=y
CONFIG_LV_FONT_MONTSERRAT_22=y
CONFIG_LV_FONT_MONTSERRAT_24=y
CONFIG_LV_FONT_MONTSERRAT_26=y
CONFIG_LV_FONT_MONTSERRAT_28=y
CONFIG_LV_MEM_SIZE_KILOBYTES=128

# PSRAM
CONFIG_SPIRAM=y
CONFIG_SPIRAM_SPEED_200M=y
CONFIG_SPIRAM_USE_MALLOC=y

# ESPP I2C (use new driver_ng API)
CONFIG_ESPP_I2C_USE_NEW_API=y
# CONFIG_ESPP_I2C_USE_LEGACY_API is not set

# Wi-Fi (ESP32-C6 via SDIO / esp_wifi_remote)
CONFIG_ESP_WIFI_REMOTE_ENABLED=y
CONFIG_ESP_WIFI_REMOTE_LIBRARY_HOSTED=y
CONFIG_SLAVE_IDF_TARGET_ESP32C6=y
CONFIG_ESP_HOSTED_IDF_SLAVE_TARGET="esp32c6"
CONFIG_ESP_HOSTED_ENABLED=y
CONFIG_ESP_HOSTED_SDIO_HOST_INTERFACE=y
CONFIG_ESP_HOSTED_SDIO_4_BIT_BUS=y
CONFIG_ESP_HOSTED_SDIO_BUS_WIDTH=4
CONFIG_ESP_HOSTED_SDIO_CLOCK_FREQ_KHZ=40000
CONFIG_ESP_HOSTED_SDIO_PIN_CMD=13
CONFIG_ESP_HOSTED_SDIO_PIN_CLK=12
CONFIG_ESP_HOSTED_SDIO_PIN_D0=11
CONFIG_ESP_HOSTED_SDIO_PIN_D1=10
CONFIG_ESP_HOSTED_SDIO_PIN_D2=9
CONFIG_ESP_HOSTED_SDIO_PIN_D3=8
CONFIG_ESP_HOSTED_SDIO_PRIV_PIN_D1_4BIT_BUS=10
CONFIG_ESP_HOSTED_SDIO_GPIO_RESET_SLAVE=15
CONFIG_ESP_HOSTED_SDIO_RESET_ACTIVE_LOW=y
CONFIG_ESP_HOSTED_GPIO_SLAVE_RESET_SLAVE=15
CONFIG_ESP_HOSTED_RESET_GPIO_ACTIVE_LOW=y

# TinyUSB HID (USB-C device mode)
CONFIG_TINYUSB_HID_COUNT=1
CONFIG_TINYUSB_DESC_MANUFACTURER_STRING="Scribe"
CONFIG_TINYUSB_DESC_PRODUCT_STRING="Scribe Tab5"
CONFIG_TINYUSB_DESC_SERIAL_STRING="SCRIBE-TAB5"

# FatFS
CONFIG_FATFS_MAX_LFN=255
CONFIG_FATFS_LFN_HEAP=y
CONFIG_ESP_MAIN_TASK_STACK_SIZE=8192
```
